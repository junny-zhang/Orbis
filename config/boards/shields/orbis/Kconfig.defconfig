## config/boards/shields/orbis/Kconfig.defconfig
```kconfig
# Copyright (c) 2026 Orbis Contributors
# SPDX-License-Identifier: MIT

if SHIELD_ORBIS_LEFT

config ZMK_KEYBOARD_NAME
    default "Orbis"

# 左手是中央：负责 BLE/USB 与主机通信，并接收右手转发来的轨迹球事件
config ZMK_SPLIT_ROLE_CENTRAL
    default y

config ZMK_POINTING
    default y

# EC11 编码器（左手）
# 注意：EC11_TRIGGER_GLOBAL_THREAD 是 choice 选项，Kconfig 里不能给它写 default
#（会触发 Kconfig warning，而 Zephyr 把 warning 当 error）。
# 所以只在这里打开驱动本身，触发方式在 orbis_left.conf 里用
# CONFIG_EC11_TRIGGER_GLOBAL_THREAD=y 选择。
config EC11
    default y

endif # SHIELD_ORBIS_LEFT

if SHIELD_ORBIS_LEFT || SHIELD_ORBIS_RIGHT

config ZMK_SPLIT
    default y

endif

if SHIELD_ORBIS_RIGHT

# 右手同时挂了 74HC595（矩阵列驱动）和 PMW3360（SPI 轨迹球）
config ZMK_POINTING
    default y

config SPI
    default y

config INPUT
    default y

endif # SHIELD_ORBIS_RIGHT
```

## config/boards/shields/orbis/Kconfig.shield
```kconfig
# Copyright (c) 2026 Orbis Contributors
# SPDX-License-Identifier: MIT

config SHIELD_ORBIS_LEFT
    def_bool $(shields_list_contains,orbis_left)

config SHIELD_ORBIS_RIGHT
    def_bool $(shields_list_contains,orbis_right)
```

## config/west.yml
```yaml
# ZMK 用户配置仓库的 west manifest
# 本文件里的 revision 全部钉到具体 commit。
# 下面两个 SHA 是 2026-10-22 GitHub Actions run #14 编译通过时的确切版本，
# 改回 main 会失去可复现性：上游一改就可能第二天变红。
# 想升级时把 SHA 换成新的、跑一次 Actions 确认通过再提交。
manifest:
  remotes:
    - name: zmkfirmware
      url-base: https://github.com/zmkfirmware
    - name: george-norton
      url-base: https://github.com/george-norton

  projects:
    - name: zmk
      remote: zmkfirmware
      revision: 4dd95d7840eb3d5a3f59bb29fbf1ab054715ef85   # zmk main @ 2026-10-22（run #14 验证通过）
      import: app/west.yml

    # PMW3360 轨迹球驱动（ZMK 外置模块，MIT）
    # revision 已钉到具体 commit（见上）
    - name: zmk-driver-pmw3360
      remote: george-norton
      revision: 0dfa2f0411b795613a35f222f993e45a1e4cc32a   # main @ 2026-10-22

  self:
    path: config
```
